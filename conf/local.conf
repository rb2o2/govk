## conf/local.conf
```bitbake
include "application"
db {
    default {
      hikaricp {
        dataSourceClassName=org.postgresql.ds.PGSimpleDataSource
        dataSource {
          serverName = localhost
          databaseName = "govk"
          user = "postgres"
          password = "admin"
        }
      }
      jndiName=ReadWriteDS
    }
  }
```
